## board/adi/ev-sc598-som/kernel.its
```
/dts-v1/;

/ {
	description = "ADSP-SC598 kernel FIT image";
	#address-cells = <1>;

	images {
		kernel {
			description = "Linux kernel";
			data = /incbin/("./Image");
			type = "kernel";
			arch = "arm64";
			os = "linux";
			compression = "none";
			load = <0x9a200000>;
			entry = <0x9a200000>;
			hash-1 {
				algo = "crc32";
			};
		};
		fdt-sc598-som-ezkit.dtb {
			description = "sc598-som-ezkit.dtb";
			data = /incbin/("./sc598-som-ezkit.dtb");
			type = "flat_dt";
			arch = "arm64";
			compression = "none";
			hash-1 {
				algo = "crc32";
			};
		};
		fdt-sc598-som-ezlite.dtb {
			description = "sc598-som-ezlite.dtb";
			data = /incbin/("./sc598-som-ezlite.dtb");
			type = "flat_dt";
			arch = "arm64";
			compression = "none";
			hash-1 {
				algo = "crc32";
			};
		};
		fdt-sc598-htol.dtb {
			description = "sc598-htol.dtb";
			data = /incbin/("./sc598-htol.dtb");
			type = "flat_dt";
			arch = "arm64";
			compression = "none";
			hash-1 {
				algo = "crc32";
			};
		};
	};

	configurations {
		default = "conf-@DEFAULT_DTB@";
		conf-sc598-som-ezkit.dtb {
			description = "Linux kernel, sc598-som-ezkit.dtb";
			kernel = "kernel";
			fdt = "fdt-sc598-som-ezkit.dtb";
		};
		conf-sc598-som-ezlite.dtb {
			description = "Linux kernel, sc598-som-ezlite.dtb";
			kernel = "kernel";
			fdt = "fdt-sc598-som-ezlite.dtb";
		};
		conf-sc598-htol.dtb {
			description = "Linux kernel, sc598-htol.dtb";
			kernel = "kernel";
			fdt = "fdt-sc598-htol.dtb";
		};
	};
};
```

## board/adi/ev-sc846-som/kernel.its
```
/dts-v1/;

/ {
	description = "ADSP-SC846 kernel FIT image";
	#address-cells = <1>;

	images {
		kernel {
			description = "Linux kernel";
			data = /incbin/("./Image");
			type = "kernel";
			arch = "arm64";
			os = "linux";
			compression = "none";
			load = <0x9a200000>;
			entry = <0x9a200000>;
			hash-1 {
				algo = "crc32";
			};
		};
		fdt-sc846-som-ezkit.dtb {
			description = "sc846-som-ezkit.dtb";
			data = /incbin/("./sc846-som-ezkit.dtb");
			type = "flat_dt";
			arch = "arm64";
			compression = "none";
			hash-1 {
				algo = "crc32";
			};
		};
	};

	configurations {
		default = "conf-@DEFAULT_DTB@";
		conf-sc846-som-ezkit.dtb {
			description = "Linux kernel, sc846-som-ezkit.dtb";
			kernel = "kernel";
			fdt = "fdt-sc846-som-ezkit.dtb";
		};
	};
};
```

## configs/adi_sc846_ezkit_defconfig
```kconfig
BR2_aarch64=y
BR2_cortex_a55=y
BR2_KERNEL_HEADERS_6_12=y
BR2_DL_DIR="$(HOME)/.buildroot-dl"
BR2_CCACHE=y
BR2_SHARED_STATIC_LIBS=y
BR2_GLOBAL_PATCH_DIR="board/adi/patches"
BR2_DOWNLOAD_FORCE_CHECK_HASHES=y
BR2_PER_PACKAGE_DIRECTORIES=y
BR2_TARGET_GENERIC_HOSTNAME="sc846-ezkit"
BR2_TARGET_GENERIC_ISSUE="Welcome to the ADI SC846 EZ-KIT"
BR2_ROOTFS_POST_IMAGE_SCRIPT="board/adi/ev-sc846-som/post-image.sh support/scripts/genimage.sh"
BR2_ROOTFS_POST_IMAGE_SCRIPT_ARGS="-c board/adi/ev-sc846-som/genimage.cfg"
BR2_LINUX_KERNEL=y
BR2_LINUX_KERNEL_CUSTOM_GIT=y
BR2_LINUX_KERNEL_CUSTOM_REPO_URL="https://github.com/analogdevicesinc/linux.git"
BR2_LINUX_KERNEL_CUSTOM_REPO_VERSION="6.18.31-3"
BR2_LINUX_KERNEL_DEFCONFIG="sc846-som-ezkit"
BR2_LINUX_KERNEL_DTS_SUPPORT=y
BR2_LINUX_KERNEL_INTREE_DTS_NAME="adi/sc846-som-ezkit"
BR2_LINUX_KERNEL_NEEDS_HOST_OPENSSL=y
BR2_PACKAGE_MTD=y
BR2_PACKAGE_MTD_MKFSUBIFS=y
BR2_TARGET_ROOTFS_EXT2=y
BR2_TARGET_ROOTFS_EXT2_4=y
BR2_TARGET_ROOTFS_EXT2_MKFS_OPTIONS=""
# BR2_TARGET_ROOTFS_TAR is not set
BR2_TARGET_ROOTFS_UBI=y
BR2_TARGET_ROOTFS_UBI_PEBSIZE=0x10000
BR2_TARGET_ROOTFS_UBI_SUBSIZE=1
BR2_TARGET_ROOTFS_UBIFS_LEBSIZE=0xff80
BR2_TARGET_ROOTFS_UBIFS_MINIOSIZE=0x1
BR2_TARGET_ROOTFS_UBIFS_MAXLEBCNT=3564
BR2_TARGET_UBOOT=y
BR2_TARGET_UBOOT_BUILD_SYSTEM_KCONFIG=y
BR2_TARGET_UBOOT_CUSTOM_TARBALL=y
BR2_TARGET_UBOOT_CUSTOM_TARBALL_LOCATION="https://github.com/analogdevicesinc/u-boot/archive/refs/tags/v2025.10-5.tar.gz"
BR2_TARGET_UBOOT_BOARD_DEFCONFIG="sc846-som-ezkit"
BR2_TARGET_UBOOT_NEEDS_OPENSSL=y
# BR2_TARGET_UBOOT_FORMAT_BIN is not set
BR2_TARGET_UBOOT_FORMAT_ELF=y
BR2_TARGET_UBOOT_FORMAT_ADSP_LDR=y
BR2_TARGET_UBOOT_SPL=y
BR2_TARGET_UBOOT_SPL_NAME="spl/u-boot-spl spl/u-boot-spl.ldr"
BR2_TARGET_UBOOT_INITIAL_ENV=y
BR2_PACKAGE_HOST_GENIMAGE=y
BR2_PACKAGE_HOST_UBOOT_TOOLS=y
BR2_PACKAGE_HOST_UBOOT_TOOLS_FIT_SUPPORT=y
```

## configs/alif_devkit_e8_defconfig
```kconfig
BR2_arm=y
BR2_cortex_a32=y
BR2_TOOLCHAIN_BUILDROOT_MUSL=y
BR2_PACKAGE_HOST_LINUX_HEADERS_CUSTOM_6_12=y
BR2_GLOBAL_PATCH_DIR="board/alif/devkit-e8/patches"
BR2_DOWNLOAD_FORCE_CHECK_HASHES=y
BR2_TARGET_GENERIC_HOSTNAME="devkit-e8"
BR2_TARGET_GENERIC_ISSUE="Welcome to Alif Ensemble DevKit-E8"
BR2_ROOTFS_POST_IMAGE_SCRIPT="board/alif/devkit-e8/post-image.sh"
BR2_LINUX_KERNEL=y
BR2_LINUX_KERNEL_CUSTOM_GIT=y
BR2_LINUX_KERNEL_CUSTOM_REPO_URL="https://github.com/alifsemi/linux_alif.git"
BR2_LINUX_KERNEL_CUSTOM_REPO_VERSION="APSS-v2.3.0"
BR2_LINUX_KERNEL_DEFCONFIG="devkit_e8"
BR2_LINUX_KERNEL_IMAGE_TARGET_CUSTOM=y
BR2_LINUX_KERNEL_IMAGE_TARGET_NAME="xipImage"
BR2_LINUX_KERNEL_DTS_SUPPORT=y
BR2_LINUX_KERNEL_INTREE_DTS_NAME="alif/ensemble/devkit/devkit-e8"
BR2_TARGET_ROOTFS_CRAMFS=y
BR2_TARGET_ROOTFS_CRAMFS_XIP=y
# BR2_TARGET_ROOTFS_TAR is not set
# BR2_TARGET_GENERIC_REMOUNT_ROOTFS_RW is not set
# BR2_PACKAGE_IFUPDOWN_SCRIPTS is not set
# BR2_PACKAGE_URANDOM_SCRIPTS is not set
BR2_TARGET_ARM_TRUSTED_FIRMWARE=y
BR2_TARGET_ARM_TRUSTED_FIRMWARE_CUSTOM_GIT=y
BR2_TARGET_ARM_TRUSTED_FIRMWARE_CUSTOM_REPO_URL="https://github.com/alifsemi/trusted-firmware-a_alif.git"
BR2_TARGET_ARM_TRUSTED_FIRMWARE_CUSTOM_REPO_VERSION="APSS-v2.3.0"
BR2_TARGET_ARM_TRUSTED_FIRMWARE_PLATFORM="devkit_e7"
BR2_TARGET_ARM_TRUSTED_FIRMWARE_ADDITIONAL_VARIABLES="AARCH32_SP=sp_min ARM_LINUX_KERNEL_AS_BL33=1 PRELOADED_BL33_BASE=0x80020000 ARM_PRELOADED_DTB_BASE=0x80010000 ALIF_TRUSTED_SRAM_BASE=0x027DE000 AP_HYPERRAM_EN=0 ISSI_HYPERRAM_EN=0 ISSI_FLASH_EN=0 MX_FLASH_EN=0 AES_EN=0"
BR2_TARGET_ARM_TRUSTED_FIRMWARE_IMAGES="bl32.bin"
```

## package/sharc-firmware/Config.in
```kconfig
config BR2_PACKAGE_SHARC_FIRMWARE
	bool "sharc-firmware"
	help
	  Pre-built SHARC firmware implementing RPMsg echo examples
	  for validating communication between Linux and the SHARC
	  cores on supported ADSP processors.

	  https://github.com/analogdevicesinc/rpmsg-examples
```
